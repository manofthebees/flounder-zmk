## config/boards/shields/flounder/Kconfig.defconfig
```kconfig
if SHIELD_FLOUNDER_LEFT
 
config ZMK_KEYBOARD_NAME
    default "flounder"
 
config ZMK_SPLIT_ROLE_CENTRAL
    default y
 
endif
 
if SHIELD_FLOUNDER_LEFT || SHIELD_FLOUNDER_RIGHT
 
config ZMK_SPLIT
    default y
 
endif
```

## config/boards/shields/flounder/Kconfig.shield
```kconfig
config SHIELD_FLOUNDER_LEFT
    def_bool $(shields_list_contains,flounder_left)
    select SHIELD_FLOUNDER

config SHIELD_FLOUNDER_RIGHT
    def_bool $(shields_list_contains,flounder_right)
    select SHIELD_FLOUNDER 
```
